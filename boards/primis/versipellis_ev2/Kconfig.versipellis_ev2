## boards/primis/versipellis_ev2/Kconfig.versipellis_ev2
```kconfig
# Copyright (c) 2026 Primis
# SPDX-License-Identifier: Apache-2.0

config BOARD_VERSIPELLIS_EV2
	select SOC_NRF52833_QDAA
```

## boards/primis/versipellis_ev2/board.yml
```yaml
# Copyright (c) 2026 Primis
# SPDX-License-Identifier: Apache-2.0

board:
  name: versipellis_ev2
  full_name: Versipellis EV2
  vendor: primis
  socs:
    - name: nrf52833
```

## boards/primis/versipellis_ev2/versipellis_ev2_defconfig
```kconfig
# Copyright (c) 2026 Primis
# SPDX-License-Identifier: Apache-2.0

CONFIG_ARM_MPU=y
CONFIG_HW_STACK_PROTECTION=y

CONFIG_USB_DEVICE_STACK=y
CONFIG_USB_DEVICE_MANUFACTURER="Primis"
CONFIG_USB_DEVICE_PRODUCT="Versipellis EV2"

# No 32.768 kHz crystal on the board: use the internal RC for LFCLK
CONFIG_CLOCK_CONTROL_NRF_K32SRC_RC=y
CONFIG_CLOCK_CONTROL_NRF_K32SRC_500PPM=y

# WS2812B status LED on SPI1 MOSI (P0.30)
CONFIG_SPI=y
CONFIG_LED_STRIP=y

# Uncomment ONLY if building for the Adafruit UF2 bootloader layout.
# Leave commented for bare-metal J-Link flashing (west flash).
#CONFIG_BUILD_OUTPUT_UF2=y
#CONFIG_FLASH_LOAD_OFFSET=0x1000

# App uses raw nrfx TIMER1 (auto-enabled from DT in newer NCS, manual on 3.1)
CONFIG_NRFX_TIMER1=y
# WS2812 present: select the RGB status color mapping (provides LED_DEFAULT_COLOR_*)
CONFIG_LED_RGB_COLOR=y
```
